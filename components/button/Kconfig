## components/button/Kconfig
```kconfig
menu "Button"

    config PUSH_BUTTON_TIMER_MS
        int "Button press counting time in ms"
        default 5000
        help
            Defines the timeout for button presses.
    
   
    config PUSH_BUTTON_TASK_STACK_SIZE
        int "Button update task stack size"
        default 4
        help
            Configure the stack size of the button task.

    config PUSH_BUTTON_TASK_PRIORITY
        int "Button update task priority"
        default 7
    
endmenu
```

## components/mics6814/Kconfig
```kconfig
menu "MICS6814"

    config MICS6814_GPIO_NO2
        int "MICS6814 NO2 GPIO Num"
        default 32
        help
            GPIO number for MICS6814 NO2 gas data line.

    config MICS6814_GPIO_NH3
        int "MICS6814 NH3 GPIO Num"
        default 33
        help
            GPIO number for MICS6814 NH3 gas data line.

    config MICS6814_GPIO_CO
        int "MICS6814 CO GPIO Num"
        default 25
        help
            GPIO number for MICS6814 CO gas data line.

    config CALIBRATION_ATTEMPS_MAX
        int "MICS6814 maximum number of calibration cycles"
        default 20
        help
            Maximum number of calibration cycles.

    config NO_OF_SAMPLES
        int "MICS6814 number of samples for one measurement"
        default 64
        help
            Number of samples for one measurement.

endmenu
```

## main/Kconfig.projbuild
```kconfig
menu "Meteo Configuration"

     menu "SSD1306 Configuration"  
        choice PANEL
            prompt "Panel Type"
            default SSD1306_128x64
            help
                Select Panel Type.
            config SSD1306_128x32
                bool "128x32 Panel"
                help
                    Panel is 128x32.
            config SSD1306_128x64
                bool "128x64 Panel"
                help
                    Panel is 128x64.
        endchoice       
    
    endmenu   

    menu "RESET Delays"  
        config RESET_ESP32
            int "Press time to restart ESP32"
            default 5000
            help
            Specify press time in milliseconds before restart ESP32.                       

        config RESET_ARDUINO
            int "Press time to restart Arduino"
            default 10000
            help
            Specify press time in milliseconds before restart Arduino.                       

        config SETUP_MODE_ESP32
            int "Press time to setup mode ESP32"
            default 15000
            help
            Specify press time in milliseconds before setup mode ESP32.                       
                    
    endmenu   

endmenu
```

## sdkconfig.defaults
```kconfig
CONFIG_SECURE_BOOT=no
CONFIG_LWIP_IPV6=y
CONFIG_HTTPD_MAX_URI_LEN=16384
CONFIG_ESPTOOLPY_FLASHSIZE_4MB=y
CONFIG_ESPTOOLPY_FLASHSIZE="4MB"
CONFIG_PARTITION_TABLE_CUSTOM=y
CONFIG_PARTITION_TABLE_CUSTOM_FILENAME="partitions_custom.csv"
CONFIG_PARTITION_TABLE_FILENAME="partitions_custom.csv"
```
